## config/west.yml
```yaml
manifest:
  remotes:
    - name: zmkfirmware
      url-base: https://github.com/ftc/
  projects:
    - name: zmk
      remote: zmkfirmware
      revision: mouse-ftc  # custom branch name
      import: app/west.yml
  self:
    path: config
```
